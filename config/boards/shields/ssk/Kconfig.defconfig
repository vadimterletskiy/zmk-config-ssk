## config/boards/shields/ssk/Kconfig.defconfig
```kconfig
if SHIELD_SSK

config ZMK_KEYBOARD_NAME
    default "SSKoy619"

config SPI
    default y
    
# enable pinctrl
CONFIG_PINCTRL=y

# enable GPIO
CONFIG_GPIO=y

# https://zmk.dev/docs/troubleshooting/connection-issues
CONFIG_BT_CTLR_TX_PWR_PLUS_8=y
CONFIG_BT_CTLR_PHY_2M=n

endif
```
